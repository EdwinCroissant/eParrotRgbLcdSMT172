/* Copyright (C) 2017 Edwin Croissant
 *
 * This program is free software: you can redistribute it and/or modify
 * it under the terms of the version 3 GNU General Public License as
 * published by the Free Software Foundation.
 */
#include "Arduino.h"
#include <I2C.h>				//https://github.com/rambo/I2C
#include <RgbLcdKeyShieldI2C.h>	//https://github.com/EdwinCroissantArduinoLibraries/RgbLcdKeyShieldI2C

const char msgSplash1[] PROGMEM = "ABV table flash";
const char msgSplash2[] PROGMEM = "V 0.03   (c) EC";
const char msgStart1[] PROGMEM = "U=flash D=check";
const char msgStart2[] PROGMEM = "LRS this screen";
const char msgOk[] PROGMEM = " OK";
const char msgFail[] PROGMEM = " Fail";
const char msgNoEeprom1[] PROGMEM = "No EEPROM at";
const char msgNoEeprom2[] PROGMEM = "I2C addr. 0x50";
uint16_t VaporAddress;
char lineBuffer[20];
uint16_t Counter = 0;

const uint8_t EepromAddress = 0x50;

/*----make instance of the lcd ----*/
RgbLcdKeyShieldI2C lcd(true);	//inverted backlight
// RgbLcdKeyShieldI2C lcd;				// non inverted backlight


/*------- Tables to be transferred---------*/
const static uint16_t LiquidABV[] PROGMEM = {
		 966, 963, 960, 958, 956, 953, 951, 949, 947, 940, 937, 936, 936, 934, 933, 932, 930, 929, 928, 927,
		 926, 925, 923, 922, 921, 919, 918, 917, 916, 915, 914, 914, 913, 912, 911, 910, 907, 905, 904, 903,
		 902, 901, 900, 899, 898, 897, 895, 894, 893, 892, 892, 891, 890, 888, 887, 886, 885, 885, 884, 883,
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		   1,   1,   0
};

const static uint16_t VaporABV[] PROGMEM = {
	    967, 964, 961, 960, 958, 956, 954, 953, 951, 946, 944, 944, 944, 943, 942, 941, 940, 939, 939, 938,
	    937, 937, 936, 935, 934, 934, 933, 932, 932, 931, 930, 930, 930, 930, 929, 928, 927, 925, 925, 924,
	    924, 923, 922, 922, 921, 920, 920, 919, 919, 918, 918, 918, 917, 916, 916, 915, 915, 915, 914, 914,
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	      6,   3,   0
};


uint16_t eepromWriteP(const uint16_t address, const char* data, const uint16_t size) {
	/*
	 * The eeprom page size is 64 bytes.
	 * Physical page boundaries start at addresses that are integer
	 * multiples of the page size and end at addresses that are
	 * integer [multiples of page size] - 1;
	 */
	uint16_t n = 0;
	while (n < size) {
		I2c._start();
		I2c._sendAddress(SLA_W(EepromAddress));
		I2c._sendByte(highByte(address + n));
		I2c._sendByte(lowByte(address + n));
		do {
			I2c._sendByte(pgm_read_byte(data + n));
			n++;
		} while ((n < size) && ((address + n) % 64));
		I2c._stop();
		delay(5);
	}
	return n;
}

uint16_t epromReadWord(uint16_t address) {
	union {
		uint8_t value8[2];
		uint16_t value16;
	} value;
	I2c._start();
	I2c._sendAddress(SLA_W(EepromAddress));
	I2c._sendByte(highByte(address));
	I2c._sendByte(lowByte(address));
	I2c._start();
	I2c._sendAddress(SLA_R(EepromAddress));
	I2c._receiveByte(1, &value.value8[0]);
	I2c._receiveByte(0, &value.value8[1]);
	I2c._stop();
	return value.value16;
}

void fillEeprom() {
	uint16_t tempAddress = 0;
	lcd.clear();
	tempAddress = tempAddress + eepromWriteP(tempAddress, (char*) LiquidABV, sizeof(LiquidABV));
	lcd.print(tempAddress, HEX);
	VaporAddress = tempAddress;
	tempAddress = tempAddress + eepromWriteP(tempAddress, (char*) VaporABV, sizeof(VaporABV));
	lcd.setCursor(7,0);
	lcd.print(tempAddress, HEX);
	lcd.setCursor(0,1);
	lcd.print(F("Done!"));
}


void verifyEeprom() {
	uint16_t i;
	uint16_t errorCount = 0;
	lcd.clear();
	for (i = 0; i < sizeof(LiquidABV) / 2; ++i) {
		lcd.setCursor(0, 0);
		lcd.print(i, DEC);
		if (pgm_read_word(&LiquidABV[i]) != epromReadWord(0 + i * 2))
			errorCount++;
		lcd.setCursor(8, 0);
		lcd.print(errorCount, DEC);
	}
	if (errorCount)
		lcd.printP(msgFail);
	else
		lcd.printP(msgOk);

	errorCount = 0;
	for (i = 0; i < sizeof(VaporABV) / 2; ++i) {
		lcd.setCursor(0, 1);
		lcd.print(i, DEC);
		if (pgm_read_word(&VaporABV[i]) != epromReadWord(VaporAddress + i * 2))
			errorCount++;
		lcd.setCursor(8, 1);
		lcd.print(errorCount, DEC);
	}
	if (errorCount)
		lcd.printP(msgFail);
	else
		lcd.printP(msgOk);
}

//The setup function is called once at startup of the sketch
void setup() {
	I2c.begin();
	I2c.setSpeed(1);
	I2c.timeOut(10);
	lcd.begin();
	lcd.setColor(RgbLcdKeyShieldI2C::clWhite);
	VaporAddress = sizeof(LiquidABV);

	// show splash
	lcd.printP(msgSplash1);
	lcd.setCursor(0,1);
	lcd.printP(msgSplash2);
	delay(2000);

    uint8_t returnStatus = 0;
    returnStatus = I2c._start();
    if (!returnStatus) returnStatus = I2c._sendAddress(SLA_W(EepromAddress));
    if (returnStatus) {
    	lcd.clear();
    	lcd.setCursor(0,0);
    	lcd.printP(msgNoEeprom1);
    	lcd.setCursor(0,1);
    	lcd.printP(msgNoEeprom2);
    	while(true){};
     }
    I2c._stop();
 	showMainInit();
}

// The loop function is called in an endless loop
void loop() {
	lcd.readKeys();
}

void showMainInit() {
	lcd.clear();
	lcd.noCursor();
	lcd.printP(msgStart1);
	lcd.setCursor(0,1);
	lcd.printP(msgStart2);
	lcd.clearKeys();
	lcd.keyUp.onShortPress = fillEeprom;
	lcd.keyDown.onShortPress = verifyEeprom;
	lcd.keyRight.onShortPress =  showMainInit;
	lcd.keyLeft.onShortPress =  showMainInit;
	lcd.keySelect.onShortPress = showMainInit;
}




